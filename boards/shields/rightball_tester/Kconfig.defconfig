## boards/shields/rightball_tester/Kconfig.defconfig
```kconfig
if SHIELD_RIGHTBALL_TESTER_LEFT

# Name must be less than 16 characters long!
config ZMK_KEYBOARD_NAME
    default "rightball_tst"

config ZMK_SPLIT_ROLE_CENTRAL
    default y

config ZMK_SPLIT_BLE_CENTRAL_PERIPHERALS
  default 1

config BT_MAX_CONN
  default 6

config BT_MAX_PAIRED
  default 6

endif

if SHIELD_RIGHTBALL_TESTER_LEFT || SHIELD_RIGHTBALL_TESTER_RIGHT

config ZMK_SPLIT
    default y

config ZMK_POINTING
    default y

endif

# ---------------------
# Kconfig for shield "rightball_tester_right" with board "nice_nano_v2"
# ---------------------
if BOARD_NICE_NANO_V2 && SHIELD_RIGHTBALL_TESTER_RIGHT

config SPI
    default y

config PMW3610
    default y

endif
```

## boards/shields/rightball_tester/Kconfig.shield
```kconfig
config SHIELD_RIGHTBALL_TESTER_LEFT
    def_bool $(shields_list_contains,rightball_tester_left)
  
config SHIELD_RIGHTBALL_TESTER_RIGHT
    def_bool $(shields_list_contains,rightball_tester_right)
  
```
